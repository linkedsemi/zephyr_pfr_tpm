## dts/bindings/linkedsemi,spi-filter.yaml
```yaml
# Copyright (c) 2024, linkedsemi
# SPDX-License-Identifier: Apache-2.0

description: linkedsemi spi filter

compatible: "linkedsemi,spi-filter"

include: [base.yaml, pinctrl-device.yaml, reset-device.yaml]

properties:
  cmd-page-program:
      type: int
      default: 0x02
  cmd-page-program-quad-addr-quad-data:
      type: int
      default: 0x38
  cmd-erase-4kb:
      type: int
      default: 0x20
  cmd-erase-32kb:
      type: int
      default: 0x52
  cmd-erase-64kb:
      type: int
      default: 0xd8
  cmd-read:
      type: int
      default: 0x03
  cmd-fast-read:
      type: int
      default: 0x0b
  cmd-read-quad-data:
      type: int
      default: 0x6b
  cmd-read-quad-addr-quad-data:
      type: int
      default: 0xeb
  cmd-quad-spi-mode-enter:
      type: int
      default: 0x35
  cmd-quad-spi-mode-exit:
      type: int
      default: 0xf5
  cmd-4byte-mode-enter:
      type: int
      default: 0xb7
  cmd-4byte-mode-exit:
      type: int
      default: 0xe9
  cmd-4byte-read-extended-addr:
      type: int
      default: 0xc8
  cmd-4byte-write-extended-addr:
      type: int
      default: 0xc5
  cmd-4byte-page-program:
      type: int
      default: 0x12
  cmd-4byte-page-program-quad-addr-quad-data:
      type: int
      default: 0x3e
  cmd-4byte-erase-4kb:
      type: int
      default: 0x21
  cmd-4byte-erase-32kb:
      type: int
      default: 0x5c
  cmd-4byte-erase-64kb:
      type: int
      default: 0xdc
  cmd-4byte-read:
      type: int
      default: 0x13
  cmd-4byte-fast-read:
      type: int
      default: 0x0c
  cmd-4byte-read-quad-data:
      type: int
      default: 0x6c
  cmd-4byte-read-quad-addr-quad-data:
      type: int
      default: 0xec
  cmd-read-dual-data:
      type: int
      default: 0x3b
  cmd-read-dual-addr-dual-data:
      type: int
      default: 0xbb
  cmd-4byte-read-dual-data:
      type: int
      default: 0x3c
  cmd-4byte-read-dual-addr-dual-data:
      type: int
      default: 0xbc
  cmd-program-quad-data:
      type: int
      default: 0x32
  cmd-4byte-program-quad-data:
      type: int
      default: 0x34
  cmd-page-program-dummy:
      type: int
      default: 0
  cmd-page-program-quad-addr-quad-data-dummy:
      type: int
      default: 0
  cmd-erase-4kb-dummy:
      type: int
      default: 0
  cmd-erase-32kb-dummy:
      type: int
      default: 0
  cmd-erase-64kb-dummy:
      type: int
      default: 0
  cmd-read-dummy:
      type: int
      default: 0
  cmd-fast-read-dummy:
      type: int
      default: 8
  cmd-read-quad-data-dummy:
      type: int
      default: 8
  cmd-read-quad-addr-quad-data-dummy:
      type: int
      default: 6
  cmd-quad-spi-mode-enter-dummy:
      type: int
      default: 0
  cmd-quad-spi-mode-exit-dummy:
      type: int
      default: 0
  cmd-4byte-mode-enter-dummy:
      type: int
      default: 0
  cmd-4byte-mode-exit-dummy:
      type: int
      default: 0
  cmd-4byte-read-extended-addr-dummy:
      type: int
      default: 0
  cmd-4byte-write-extended-addr-dummy:
      type: int
      default: 0
  cmd-4byte-page-program-dummy:
      type: int
      default: 0
  cmd-4byte-page-program-quad-addr-quad-data-dummy:
      type: int
      default: 0
  cmd-4byte-erase-4kb-dummy:
      type: int
      default: 0
  cmd-4byte-erase-32kb-dummy:
      type: int
      default: 0
  cmd-4byte-erase-64kb-dummy:
      type: int
      default: 0
  cmd-4byte-read-dummy:
      type: int
      default: 0
  cmd-4byte-fast-read-dummy:
      type: int
      default: 8
  cmd-4byte-read-quad-data-dummy:
      type: int
      default: 8
  cmd-4byte-read-quad-addr-quad-data-dummy:
      type: int
      default: 6
  cmd-read-dual-data-dummy:
      type: int
      default: 8
  cmd-read-dual-addr-dual-data-dummy:
      type: int
      default: 4
  cmd-4byte-read-dual-data-dummy:
      type: int
      default: 8
  cmd-4byte-read-dual-addr-dual-data-dummy:
      type: int
      default: 4
  cmd-program-quad-data-dummy:
      type: int
      default: 0
  cmd-4byte-program-quad-data-dummy:
      type: int
      default: 0
  spi:
      type: phandle
      description: spi controller node
  cs-gpios:
      type: phandle-array
      description: |
        An array of chip select GPIOs to use. Each element
        in the array specifies a GPIO. The index in the array
        corresponds to the child node that the CS gpio controls.

        Example:

            spi@... {
                    cs-gpios = <&gpio0 23 GPIO_ACTIVE_LOW>,
                                <&gpio1 10 GPIO_ACTIVE_LOW>,
                                ...;

                    spi-device@0 {
                            reg = <0>;
                            ...
                    };
                    spi-device@1 {
                            reg = <1>;
                            ...
                    };
                    ...
            };

        The child node "spi-device@0" specifies a SPI device with
        chip select controller gpio0, pin 23, and devicetree
        GPIO flags GPIO_ACTIVE_LOW. Similarly, "spi-device@1" has CS GPIO
        controller gpio1, pin 10, and flags GPIO_ACTIVE_LOW. Additional
        devices can be configured in the same way.

        If unsure about the flags cell, GPIO_ACTIVE_LOW is generally a safe
        choice for a typical "CSn" pin. GPIO_ACTIVE_HIGH may be used if
        intervening hardware inverts the signal to the peripheral device or
        the line itself is active high.

        If this property is not defined, no chip select GPIOs are set.
        SPI controllers with dedicated CS pins do not need to define
        the cs-gpios property.
  index:
      type: int
      default: 0
```

## zephyr/Kconfig
```kconfig
# Copyright (c) 2024 linkedsemi
# SPDX-License-Identifier: Apache-2.0

config PFR_TPM_LINKER_LD
    bool "pfr_tpm project default linker.ld"
    default y
    depends on SPI_FILTER_LINKEDSEMI

rsource "Kconfig.i2cfilter"
rsource "Kconfig.spifilter"
rsource "Kconfig.spid"
```

## zephyr/Kconfig.i2cfilter
```kconfig
# Copyright (c) 2024 linkedsemi
# SPDX-License-Identifier: Apache-2.0

config I2C_FILTER_LINKEDSEMI
    bool "i2c filter"
    default y
    depends on DT_HAS_LINKEDSEMI_I2C_FILTER_ENABLED
    select I2C
    help
      I2C_FILTER_LINKEDSEMI
```

## zephyr/Kconfig.spid
```kconfig
# Copyright (c) 2024 linkedsemi <htliu@linkedsemi.com>
# SPDX-License-Identifier: Apache-2.0

config SPID_LINKEDSEMI
    bool "tpm SPI device"
    default y
    depends on DT_HAS_LINKEDSEMI_SPID_ENABLED # external modual can not set
    help
      SPID_LINKEDSEMI
```

## zephyr/Kconfig.spifilter
```kconfig
# Copyright (c) 2024 linkedsemi
# SPDX-License-Identifier: Apache-2.0

config SPI_FILTER_LINKEDSEMI
    bool "spi filter"
    default y
    depends on DT_HAS_LINKEDSEMI_SPI_FILTER_ENABLED
    select SPI
    select DMA
    help
      SPI_FILTER_LINKEDSEMI

config SPI_FILTER_LINKEDSEMI_SHELL
    bool "spi filter"
    default y
    depends on DT_HAS_LINKEDSEMI_SPI_FILTER_ENABLED && SHELL
    help
      SPI_FILTER_LINKEDSEMI_SHELL

config SPI_FILTER_ADDR_WHITELIST_BUF
    bool "SPI_FILTER_ADDR_WHITELIST_BUF"
    default y
    help
      SPI_FILTER_ADDR_WHITELIST_BUF

config SPIM_NAME
    bool "SPIM_NAME"
    default n
    help
      SPIM_NAME

config SPI_FILTER_INTERRUPT_LOG
    bool "SPI_FILTER_INTERRUPT_LOG"
    default y
    help
      SPI_FILTER_INTERRUPT_LOG

config SPI_FILTER_DMA_LOG
    bool "SPI_FILTER_DMA_LOG"
    default y
    help
      SPI_FILTER_DMA_LOG

config SPI_FILTER_DMA_LOG_SIZE
    int "SPI_FILTER_DMA_LOG_SIZE"
    default 8188
    range 32 8188
    help
      SPI_FILTER_DMA_LOG_SIZE
```

## zephyr/Kconfig.spimonitor
```kconfig
# Copyright (c) 2024 linkedsemi
# SPDX-License-Identifier: Apache-2.0

config SPI_MONITOR_LINKEDSEMI
    bool "spi monitor"
    default y
    depends on DT_HAS_LINKEDSEMI_SPI_MONITOR_ENABLED
    help
      SPI_MONITOR_LINKEDSEMI
```
