/*
 * Copyright (c) 2024, linkedsemi
 * SPDX-License-Identifier: Apache-2.0
 */

/ {
    aliases {
        led0 = &led0;
    };

    leds {
        compatible = "gpio-leds";
        led0: led_0{
            gpios = <&gpiot 15 GPIO_ACTIVE_HIGH>;
            label = "Blue LED";
        };
    };
};
